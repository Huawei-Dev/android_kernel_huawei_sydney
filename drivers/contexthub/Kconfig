## drivers/contexthub/Kconfig
```kconfig
config CONTEXTHUB
	bool "Sensor CONTEXTHUB driver"
	depends on INPUTHUB || INPUTHUB_20
	default n
	help
	Sensor CONTEXTHUB driver.

config CONTEXTHUB_SHMEM
	bool "Sensor CONTEXTHUB SHMEM driver"
	depends on INPUTHUB || INPUTHUB_20
	default y
	help
	Say yes here if you want to configure contexthub share memory

config CONTEXTHUB_LOADMONITOR
	bool "Sensor CONTEXTHUB LOADMONITOR driver"
	depends on CONTEXTHUB
	default n
	help
	Say yes here if you want to use contexthub shell dbg function

config INPUTHUB_MOCK_SENSOR
	bool "mock sensor feature support"
	depends on INPUTHUB_20
	default n
	help
	Say yes here if you want to configure INPUTHUB_MOCK_SENSOR

source "drivers/contexthub/flp/Kconfig"
```

## kernel/sched/Kconfig
```kconfig
config SCHED_HISI_DOWNMIGRATE_LOWER_LOAD
	bool "Schedutil governor use lower load when task downmigrate"
	depends on SCHED_WALT
	depends on CPU_FREQ_GOV_SCHEDUTIL
	default n
	help
	  Schedutil governor migrate cpu busy time when task migrate. This
	  option will recaculate a lower load for task downmigrate to
	  prevent little core's frequency increase too much.

config SCHED_HISI_CHECK_IRQLOAD
	bool "Scheduler check irqload when select task's cpu"
	depends on SCHED_WALT
	default n
	help
	  WALT caculates an irqload for each cpu and scheduler will avoid
	  placing task on a high irqload cpu (if WALT enabled).
	  Default disabled because we haven't tested to find out which
	  threshold is the best.

config SCHED_HISI_TOP_TASK
	bool "Maintain the top task load of each cpu"
	depends on SCHED_WALT
	default n
	help
	  Hisi schedutil governor may use the top task load as a guide to
	  frequency evaluation.

config SCHED_HISI_MIGRATE_SPREAD_LOAD
	bool "Spread task's load when inter-cluster migration"
	depends on SCHED_WALT
	default n
	help
	  In inter-cluster migration, this option will spread task's
	  prev_window/curr_window to all cpus that the task has been
	  running on before in a window. If disabled, task's whole load
	  will move to dest cpu and that will make dest cpu's cpu load
	  very high in same cases.

config SCHED_HISI_TOP_TASK_SKIP_HISPEED_LOGIC
	bool "Let top task ignore above_hipeed_delay"
	depends on SCHED_HISI_TOP_TASK
	default n
	help
	  For schedutil governor, this option skips hispeed logic when
	  ADD_TOP_TASK event triggers freq update.

config SCHED_HISI_FORCE_CMP_BACKUP
	bool "Always consider backup cpu in non-preferidle case"
	depends on HISI_EAS_SCHED
	default n
	help
	  This option compares backup_cpu if target_cpu == prev_cpu.
	  In other words, for non-prefer idle tasks it may chose an idle
	  cpu even if prev_cpu is the best active cpu.
	  Not recommended because it will make all tasks spread.
```

## mm/hisi/Kconfig
```kconfig
menuconfig HISI_MM
	bool "Hisilicon MM support"
	---help---
	  This option add some hisilicon mm codes, needed by following modules.

config HISI_PMALLOC
	bool "Protectable Memory Allocator"
	default y
	depends on MMU
	depends on HISI_MM
	select  GENERIC_ALLOCATOR
	help
	It allows to write-protect variables allocated dynamically
	ls /sys/kernel/pmalloc

config DEBUG_HISI_PMALLOC
	bool "Tests for Protectable Memory Allocator"
	default y
	depends on HISI_PMALLOC && HISI_HHEE_DEBUG
	help
	Various entries are listed under /sys/kernel/debug/pmalloc
```
