## drivers/dubai/Kconfig
```kconfig
menu "Huawei Device Usage Big-data Analytics Initiative Support"

config HUAWEI_DUBAI
	bool "Huawei Device Usage Big-data Analytics Initiative Support"
	default n
	help
	  This driver provides DUBAI feature

config HUAWEI_DUBAI_TASK_CPU_POWER
	bool "Huawei DUBAI Task CPU Power"
	default n
	depends on HUAWEI_DUBAI && ARCH_MSM
	help
	  Get task cpu power

endmenu
```

## drivers/huawei_platform/power/cpu_buck/Kconfig
```kconfig
config HUAWEI_CPU_BUCK
	bool "huawei cpu_buck"
	default n
config HI6422V200
	bool "hi6422v200"
	default n
```
